/**
  * @file    stepper.c
  * @brief   HPD322 stepper-drive control (TIM2 interrupt based)
  *
  * Design notes (inspired by the earlier TMC2209 work):
  *   1. STEP pulses are generated by the TIM2 update interrupt, non-blocking.
  *   2. The main loop only reads the sensor and updates the target speed.
  *   3. Smooth acceleration: 2 RPM per 100 ms when the RPM interface is used.
  *   4. The pulse width is produced with NOP delays (HPD322 needs >= 2.5 us).
  *
  * HPD322 driver:
  *   - Control signals: PUL+ (pulse), DIR+ (direction), EN+ (enable)
  *   - Enable logic: EN low = enabled, EN high = disabled
  *   - 3.3 V single-ended signals can be wired straight to the STM32
  *   - Maximum pulse frequency : 400 kHz
  *   - Minimum pulse width     : 2.5 us
  *
  * Wiring (unchanged):
  *   PA2 -> EN+  (enable)
  *   PA3 -> DIR+ (direction)
  *   PA4 -> PUL+ (pulse)
  *   GND -> EN-, DIR-, PUL- (signal ground)
  */

#include "stepper.h"
#include "stm32f1xx_hal_tim.h"

/* ========== Global state ========== */
static volatile uint16_t current_rpm = 0;     /* current speed [RPM] */
static TIM_HandleTypeDef htim2;               /* TIM2 handle */
static volatile uint8_t  move_running = 0;    /* 1 = a fixed-step move is in progress */
static volatile uint32_t move_count = 0;      /* pulses already emitted */
static volatile uint32_t move_target = 0;     /* target number of pulses */

/* ========== TIM2 setup, used as the step-pulse generator ==========
 * Clock : APB1 runs at 36 MHz, but the TIM2 clock is doubled to 72 MHz.
 * Prescaler 72-1 -> counting frequency 1 MHz (1 us resolution).
 * Mode  : update interrupt (one interrupt per counter overflow).
 *
 * Note: ARR is initialised to a large value (timer stopped); the actual period
 * is written by SetSpeed when a move starts.
 */
static void TIM2_Step_Init(void)
{
    __HAL_RCC_TIM2_CLK_ENABLE();              /* enable the TIM2 clock */

    htim2.Instance               = TIM2;
    htim2.Init.Prescaler         = TIM_PRESCALER;  /* 72-1: 72 MHz -> 1 MHz */
    htim2.Init.CounterMode       = TIM_COUNTERMODE_UP;
    htim2.Init.Period            = 0xFFFF;         /* large period while stopped */
    htim2.Init.ClockDivision     = TIM_CLOCKDIVISION_DIV1;
    htim2.Init.AutoReloadPreload = TIM_AUTORELOAD_PRELOAD_ENABLE;  /* ARR preload on */

    HAL_TIM_Base_Init(&htim2);

    /* TIM2 interrupt priority */
    HAL_NVIC_SetPriority(TIM2_IRQn, 1, 0);  /* high priority, pulses must be on time */
    HAL_NVIC_EnableIRQ(TIM2_IRQn);
}

/**
  * @brief  Initialise the stepper control pins and the TIM2 timebase.
  *         PA2 = EN (enable), PA3 = DIR (direction), PA4 = PUL (pulse)
  * @note   Initial state: driver disabled, TIM2 not started.
  */
void Stepper_Init(void)
{
    GPIO_InitTypeDef GPIO_InitStruct = {0};

    /* Enable the GPIOA clock */
    __HAL_RCC_GPIOA_CLK_ENABLE();

    /* PA2, PA3 and PA4 as push-pull outputs */
    GPIO_InitStruct.Pin   = STEP_PIN | DIR_PIN | ENABLE_PIN;
    GPIO_InitStruct.Mode  = GPIO_MODE_OUTPUT_PP;
    GPIO_InitStruct.Pull  = GPIO_NOPULL;
    GPIO_InitStruct.Speed = GPIO_SPEED_FREQ_HIGH;
    HAL_GPIO_Init(GPIOA, &GPIO_InitStruct);

    /* Initial state: driver disabled, so the rod cannot twitch at power-up. */
    Stepper_Disable();
    Stepper_SetDir(0);  /* default direction */
    
    /* Initialise TIM2 (the pulse generator) */
    TIM2_Step_Init();
}

/**
  * @brief  Enable the driver (EN pulled low; the HPD322 is active low).
  */
void Stepper_Enable(void)
{
    HAL_GPIO_WritePin(ENABLE_PORT, ENABLE_PIN, GPIO_PIN_RESET);  /* EN = LOW -> enabled */
}

/**
  * @brief  Disable the driver (EN pulled high; the motor coils are released).
  */
void Stepper_Disable(void)
{
    HAL_GPIO_WritePin(ENABLE_PORT, ENABLE_PIN, GPIO_PIN_SET);    /* EN = HIGH -> disabled */
}

/**
  * @brief  Set the rotation direction.
  * @param  dir: 0 = forward (DIR low), 1 = reverse (DIR high)
  * @note   Change the direction only while the motor is stopped or slow.
  */
void Stepper_SetDir(uint8_t dir)
{
    if (dir == 0)
        HAL_GPIO_WritePin(DIR_PORT, DIR_PIN, GPIO_PIN_RESET);   /* DIR=LOW  -> forward */
    else
        HAL_GPIO_WritePin(DIR_PORT, DIR_PIN, GPIO_PIN_SET);     /* DIR=HIGH -> reverse */
}

/**
  * @brief  Start TIM2 and begin emitting pulses.
  * @note   Enable the driver and set the direction first.
  */
void Stepper_Start(void)
{
    HAL_TIM_Base_Start_IT(&htim2);  /* start TIM2 with the update interrupt enabled */
}

/**
  * @brief  Stop TIM2 and stop emitting pulses.
  */
void Stepper_Stop(void)
{
    HAL_TIM_Base_Stop_IT(&htim2);  /* stop TIM2 */
    current_rpm = 0;               /* reset the reported speed */
}

/**
  * @brief  Convert an RPM target into a TIM2 ARR value and apply it.
  * @param  rpm: target speed [rev/min]
  *
  * Formula:
  *   pulse frequency [Hz] = RPM / 60 * STEPS_PER_REV
  *   timer period    [us] = 1,000,000 / pulse frequency
  *   ARR                  = timer period [us] * 1 - 1   (TIM2 counts at 1 MHz)
  *
  *   combined: ARR = 60,000,000 / (RPM * STEPS_PER_REV) - 1
  *
  * Examples (16 microsteps, STEPS_PER_REV = 3200):
  *   600 RPM: ARR = 60000000/(600*3200) - 1 = 31.25 - 1 ~ 30
  *   100 RPM: ARR = 60000000/(100*3200) - 1 = 187.5 - 1 ~ 186
  *
  * @note   ARR must never be 0 (clamped to at least 1).
  */
void Stepper_SetSpeed(uint16_t rpm)
{
    uint32_t arr;
    
    if (rpm == 0)
    {
        Stepper_Stop();
        return;
    }
    
    /* ARR = 60000000 / (RPM * STEPS_PER_REV) - 1 */
    arr = 60000000UL / ((uint32_t)rpm * STEPS_PER_REV);
    if (arr > 0) arr -= 1;
    
    /* Clamp ARR to 1 .. 0xFFFF */
    if (arr < 1) arr = 1;
    if (arr > 0xFFFF) arr = 0xFFFF;
    
    /* Write ARR (preload enabled, so it takes effect on the next update event) */
    __HAL_TIM_SET_AUTORELOAD(&htim2, arr);
    
    current_rpm = rpm;
}

/**
  * @brief  Smoothly ramp the speed towards a target (variable acceleration).
  * @param  target_rpm: final target speed
  * @param  accel_per_update: change applied on every call [RPM]
  *
  * Usage : call once every SPEED_UPDATE_INTERVAL_MS (100 ms) from the main loop.
  * Effect: acceleration = accel_per_update / SPEED_UPDATE_INTERVAL_MS * 1000
  *
  * Example: accelerate 15 RPM/100 ms -> 150 RPM/s
  *          decelerate 40 RPM/100 ms -> 400 RPM/s
  */
void Stepper_UpdateSpeed(uint16_t target_rpm, uint16_t accel_per_update)
{
    if (current_rpm < target_rpm)
    {
        /* Accelerate: add accel_per_update */
        uint16_t new_rpm = current_rpm + accel_per_update;
        if (new_rpm > target_rpm) new_rpm = target_rpm;
        Stepper_SetSpeed(new_rpm);
    }
    else if (current_rpm > target_rpm)
    {
        /* Decelerate: subtract accel_per_update */
        uint16_t new_rpm;
        if (current_rpm > accel_per_update)
            new_rpm = current_rpm - accel_per_update;
        else
            new_rpm = 0;
        if (new_rpm < target_rpm) new_rpm = target_rpm;
        Stepper_SetSpeed(new_rpm);
    }
    /* current_rpm == target_rpm: nothing to do */
}

/**
  * @brief  Report the current speed.
  * @retval current speed [RPM]
  */
uint16_t Stepper_GetCurrentRPM(void)
{
    return current_rpm;
}

/* ========================================================================
 * Fixed-step moves (used by the orange-press workflow)
 * The TIM2 interrupt counts every emitted pulse and stops the timer as soon as
 * the target count is reached, so the position error is <= 1 step and does not
 * depend on how long the main loop is blocked by an HX711 read.
 * ======================================================================== */

/**
  * @brief  Start a fixed-step move.
  * @param  steps: number of steps (> 0)
  * @param  rpm:   speed (> 0)
  * @param  dir:   direction (0 = forward, 1 = reverse, as agreed by the caller)
  * @note   The driver is enabled automatically; a call is ignored while another
  *         move is still running.
  */
void Stepper_MoveSteps(uint32_t steps, uint16_t rpm, uint8_t dir)
{
    if ((steps == 0) || (rpm == 0) || move_running)
    {
        return;
    }

    Stepper_SetDir(dir);
    Stepper_Enable();                     /* make sure the driver is enabled */
    move_target  = steps;
    move_count   = 0;
    move_running = 1;
    Stepper_SetSpeed(rpm);                /* set ARR and the reported speed */
    htim2.Instance->EGR = TIM_EGR_UG;     /* force ARR to load now (preload is on) */
    __HAL_TIM_CLEAR_IT(&htim2, TIM_IT_UPDATE); /* clear the flag raised by UG, so the
                                                  start does not emit an extra pulse */
    __HAL_TIM_SET_COUNTER(&htim2, 0);     /* counter to 0: an exact first period */
    HAL_TIM_Base_Start_IT(&htim2);
}
/**
  * @brief  Start a fixed-step move with the speed given in pulses per second.
  * @param  steps: number of steps; pps: pulses per second
  *                (1 mm/s ~ 80 pps, 30 mm/s ~ 2412 pps)
  * @note   Not limited to integer RPM, which is what mm/s motion needs.
  */
void Stepper_MoveStepsPps(uint32_t steps, uint32_t pps, uint8_t dir)
{
    uint32_t arr;

    if ((steps == 0) || (pps == 0) || move_running)
    {
        return;
    }

    Stepper_SetDir(dir);
    Stepper_Enable();
    move_target  = steps;
    move_count   = 0;
    move_running = 1;

    /* ARR [us] = 1,000,000 / pps - 1 (TIM2 counts at 1 MHz) */
    arr = 1000000u / pps;
    if (arr > 1) arr -= 1; else arr = 1;
    if (arr > 0xFFFF) arr = 0xFFFF;
    __HAL_TIM_SET_AUTORELOAD(&htim2, arr);
    current_rpm = (uint16_t)(pps * 60u / STEPS_PER_REV);  /* reported value only */

    htim2.Instance->EGR = TIM_EGR_UG;
    __HAL_TIM_CLEAR_IT(&htim2, TIM_IT_UPDATE);
    __HAL_TIM_SET_COUNTER(&htim2, 0);
    HAL_TIM_Base_Start_IT(&htim2);
}

/**
  * @brief  Is a move still in progress?
  * @retval 1 = moving, 0 = finished / idle
  */
uint8_t Stepper_MoveBusy(void)
{
    return move_running;
}

/**
  * @brief  Stop the current move immediately (the driver keeps holding torque).
  * @note   Stepper_GetRemainingSteps() then reports how many steps are left,
  *         which allows the move to be resumed later.
  */
void Stepper_MoveAbort(void)
{
    if (move_running)
    {
        HAL_TIM_Base_Stop_IT(&htim2);
        move_running = 0;
        current_rpm  = 0;
    }
}

/**
  * @brief  Steps remaining from the last move (target - emitted).
  */
uint32_t Stepper_GetRemainingSteps(void)
{
    return (move_target > move_count) ? (move_target - move_count) : 0;
}

/**
  * @brief  TIM2 update interrupt handler: generates one STEP pulse.
  *         Called on every timer overflow.
  *
  * Pulse sequence:
  *   1. STEP high
  *   2. delay of about 3 us (HPD322 needs >= 2.5 us, so there is margin)
  *   3. STEP low
  *
  * @note   At 72 MHz one NOP is about 14 ns, so 3 us is about 214 NOPs; 200
  *         NOPs (~2.78 us) is used, which leaves 0.3 us of margin.
  */
void TIM2_IRQHandler(void)
{
    if (__HAL_TIM_GET_FLAG(&htim2, TIM_FLAG_UPDATE) != RESET)
    {
        __HAL_TIM_CLEAR_IT(&htim2, TIM_IT_UPDATE);
        
        /* === STEP pulse, high level === */
        STEP_PORT->BSRR = STEP_PIN;  /* direct register write: fastest option */
        
        /* Delay of about 3 us (HPD322 needs >= 2.5 us)
         * At 72 MHz 200 NOPs are about 2.78 us. */
        __NOP(); __NOP(); __NOP(); __NOP(); __NOP(); __NOP(); __NOP(); __NOP(); __NOP(); __NOP();
        __NOP(); __NOP(); __NOP(); __NOP(); __NOP(); __NOP(); __NOP(); __NOP(); __NOP(); __NOP();
        __NOP(); __NOP(); __NOP(); __NOP(); __NOP(); __NOP(); __NOP(); __NOP(); __NOP(); __NOP();
        __NOP(); __NOP(); __NOP(); __NOP(); __NOP(); __NOP(); __NOP(); __NOP(); __NOP(); __NOP();
        __NOP(); __NOP(); __NOP(); __NOP(); __NOP(); __NOP(); __NOP(); __NOP(); __NOP(); __NOP();
        __NOP(); __NOP(); __NOP(); __NOP(); __NOP(); __NOP(); __NOP(); __NOP(); __NOP(); __NOP();
        __NOP(); __NOP(); __NOP(); __NOP(); __NOP(); __NOP(); __NOP(); __NOP(); __NOP(); __NOP();
        __NOP(); __NOP(); __NOP(); __NOP(); __NOP(); __NOP(); __NOP(); __NOP(); __NOP(); __NOP();
        __NOP(); __NOP(); __NOP(); __NOP(); __NOP(); __NOP(); __NOP(); __NOP(); __NOP(); __NOP();
        __NOP(); __NOP(); __NOP(); __NOP(); __NOP(); __NOP(); __NOP(); __NOP(); __NOP(); __NOP();
        /* 100 NOPs so far, about 1.39 us */
        __NOP(); __NOP(); __NOP(); __NOP(); __NOP(); __NOP(); __NOP(); __NOP(); __NOP(); __NOP();
        __NOP(); __NOP(); __NOP(); __NOP(); __NOP(); __NOP(); __NOP(); __NOP(); __NOP(); __NOP();
        __NOP(); __NOP(); __NOP(); __NOP(); __NOP(); __NOP(); __NOP(); __NOP(); __NOP(); __NOP();
        __NOP(); __NOP(); __NOP(); __NOP(); __NOP(); __NOP(); __NOP(); __NOP(); __NOP(); __NOP();
        __NOP(); __NOP(); __NOP(); __NOP(); __NOP(); __NOP(); __NOP(); __NOP(); __NOP(); __NOP();
        __NOP(); __NOP(); __NOP(); __NOP(); __NOP(); __NOP(); __NOP(); __NOP(); __NOP(); __NOP();
        __NOP(); __NOP(); __NOP(); __NOP(); __NOP(); __NOP(); __NOP(); __NOP(); __NOP(); __NOP();
        __NOP(); __NOP(); __NOP(); __NOP(); __NOP(); __NOP(); __NOP(); __NOP(); __NOP(); __NOP();
        __NOP(); __NOP(); __NOP(); __NOP(); __NOP(); __NOP(); __NOP(); __NOP(); __NOP(); __NOP();
        __NOP(); __NOP(); __NOP(); __NOP(); __NOP(); __NOP(); __NOP(); __NOP(); __NOP(); __NOP();
        /* 200 NOPs, about 2.78 us */
        
        /* === STEP pulse, low level === */
        STEP_PORT->BSRR = (uint32_t)STEP_PIN << 16;  /* pull STEP low */

        /* === Fixed-step counting ===
         * One count per pulse; the timer is stopped inside the interrupt as soon
         * as the target is reached, so there is no overshoot. */
        if (move_running)
        {
            move_count++;
            if (move_count >= move_target)
            {
                move_running = 0;
                current_rpm  = 0;
                HAL_TIM_Base_Stop_IT(&htim2);
            }
        }
    }
}
